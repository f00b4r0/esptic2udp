## components/tic2json/Kconfig
```kconfig
menu "tic2json"

    choice
    prompt "TIC version"
    default TIC2JSON_TICV02
    config TIC2JSON_TICV01
        bool "01 (Historique)"
    config TIC2JSON_TICV02
        bool "02 (Standard)"
    endchoice

    config TIC2JSON_MASKZEROES
    bool "Skip datasets with 0-value"
    default y

    config TIC2JSON_DICTOUT
    bool "Enable dictionary output"
    default y

    config TIC2JSON_LONGDATE
    bool "Enable RFC3339 date format output"
    
endmenu
```

## main/Kconfig
```kconfig
menu "esptic2udp"

config ESPTIC2UDP_UART_NUM
    int "TIC UART"
    default 0
    help
        UART peripheral to use for TIC input

choice
    prompt "TIC baudrate"
    default ESPTIC2UDP_B9600
    config ESPTIC2UDP_B1200
        bool "1200 (Historique)"
    config ESPTIC2UDP_B9600
        bool "9600 (Standard)"
endchoice

config ESPTIC2UDP_BAUDRATE
    int
    default 1200 if ESPTIC2UDP_B1200
    default 9600

menuconfig ESPTIC2UDP_HAS_LED
    bool "Signal operation via LED"
    default n
    help
        Set to enable indicator LED

if ESPTIC2UDP_HAS_LED
    config ESPTIC2UDP_LED_GPIO_NUM
        int "LED GPIO NUM"
        default 2

    config ESPTIC2UDP_LED_ACTIVE_HIGH
        bool "LED active high"
        help
            Set if LED is active high, unset otherwise

    config ESPTIC2UDP_LED_ACTIVE_STATE
        int
        default 1 if ESPTIC2UDP_LED_ACTIVE_HIGH
        default 0
endif

config ESPTIC2UDP_UDP_HOST
    string "UDP remote hostname"
    default "myhost"

config ESPTIC2UDP_UDP_PORT
    string "UDP remote port"
    default "8094"

endmenu
```
